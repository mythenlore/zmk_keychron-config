## config/boards/shields/b1_matrix_probe/Kconfig.defconfig
```kconfig
if SHIELD_B1_MATRIX_PROBE

config ZMK_KEYBOARD_NAME
    default "B1 Probe"

endif
```

## config/boards/shields/b1_matrix_probe/Kconfig.shield
```kconfig
config SHIELD_B1_MATRIX_PROBE
    def_bool $(shields_list_contains,b1_matrix_probe)
```

## config/boards/shields/b1_new_hw/Kconfig.defconfig
```kconfig
if SHIELD_B1_NEW_HW

config ZMK_KEYBOARD_NAME
    default "Keychron B1 Pro"

endif
```

## config/west.yml
```yaml
manifest:
  remotes:
    - name: keychron
      url-base: https://github.com/Keychron

  projects:
    - name: zmk
      remote: keychron
      revision: keychron_bpro
      import: app/west.yml

  self:
    path: config
```
